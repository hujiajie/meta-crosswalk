## conf/layer.conf
```bitbake
BBPATH .= ":${LAYERDIR}"
BBFILES += "${LAYERDIR}/recipes-*/*/*.bb ${LAYERDIR}/recipes-*/*/*.bbappend"
BBFILE_COLLECTIONS += "crosswalk"
BBFILE_PATTERN_crosswalk = "^${LAYERDIR}/"
BBFILE_PRIORITY_crosswalk = "9"
LAYERDEPENDS_crosswalk = "core openembedded-layer"
```
